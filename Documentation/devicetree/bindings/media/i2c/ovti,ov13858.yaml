## Documentation/devicetree/bindings/media/i2c/ovti,ov13858.yaml
```yaml
# SPDX-License-Identifier: (GPL-2.0-only OR BSD-2-Clause)
%YAML 1.2
---
$id: http://devicetree.org/schemas/media/i2c/ovti,ov13858.yaml#
$schema: http://devicetree.org/meta-schemas/core.yaml#

title: Omnivision OV13858 CMOS Sensor

maintainers:
  - Sakari Ailus <sakari.ailus@linux.intel.com>

description: |
  The Omnivision OV13858 is a 13.2 megapixel, CMOS image sensor with an
  active array size of 4224H x 3136V. It supports:
  - Automatic black level calibration (BLC)
  - Programmable controls for frame rate, mirror and flip, binning,
    cropping and windowing
  - Output format 10-bit Bayer RAW
  - 4-lane MIPI D-PHY TX @ 1.08 Gbps per lane
  - Standard SCCB command interface

allOf:
  - $ref: /schemas/media/video-interface-devices.yaml#

properties:
  compatible:
    const: ovti,ov13858

  reg:
    maxItems: 1

  clocks:
    description: XVCLK external clock, 19.2 MHz.
    maxItems: 1

  avdd-supply:
    description: Analogue circuit voltage supply.

  dovdd-supply:
    description: I/O circuit voltage supply.

  dvdd-supply:
    description: Digital circuit voltage supply.

  reset-gpios:
    description: Active low GPIO connected to XSHUTDOWN pad of the sensor.

  port:
    $ref: /schemas/graph.yaml#/$defs/port-base
    additionalProperties: false

    properties:
      endpoint:
        $ref: /schemas/media/video-interfaces.yaml#
        additionalProperties: false

        properties:
          data-lanes:
            items:
              - const: 1
              - const: 2
              - const: 3
              - const: 4
          link-frequencies: true
          remote-endpoint: true

        required:
          - data-lanes
          - link-frequencies
          - remote-endpoint

required:
  - compatible
  - reg
  - clocks
  - port

unevaluatedProperties: false

examples:
  - |
    #include <dt-bindings/gpio/gpio.h>

    i2c {
        #address-cells = <1>;
        #size-cells = <0>;

        ov13858: camera@10 {
            compatible = "ovti,ov13858";
            reg = <0x10>;

            reset-gpios = <&tlmm 110 GPIO_ACTIVE_LOW>;
            pinctrl-names = "default";
            pinctrl-0 = <&cam_rear_default>;

            clocks = <&camcc_mclk1>;

            assigned-clocks = <&camcc_mclk1>;
            assigned-clock-rates = <19200000>;

            avdd-supply = <&vreg_l5m_2p8>;
            dvdd-supply = <&vreg_l1m_1p2>;
            dovdd-supply = <&vreg_l6m_1p8>;

            port {
                ov13858_ep: endpoint {
                    remote-endpoint = <&csiphy0_ep>;
                    data-lanes = <1 2 3 4>;
                    link-frequencies = /bits/ 64 <540000000 270000000>;
                };
            };
        };
    };
...
```

## Documentation/devicetree/bindings/media/i2c/st,vd55g0.yaml
```yaml
# SPDX-License-Identifier: (GPL-2.0-only OR BSD-2-Clause)
# Copyright (c) 2022 STMicroelectronics SA.
%YAML 1.2
---
$id: http://devicetree.org/schemas/media/i2c/st,vd55g0.yaml#
$schema: http://devicetree.org/meta-schemas/core.yaml#

title: STMicroelectronics VD55G0 HDR global-shutter image sensor

maintainers:
  - Benjamin Mugnier <benjamin.mugnier@foss.st.com>
  - Sylvain Petinot <sylvain.petinot@foss.st.com>

description: |
  VD55G0 is a 644x604 global-shutter image sensor with a one- or two-lane
  CSI-2 output. Supported formats are RAW8, RAW10, RAW12, RAW14 and RAW16.

allOf:
  - $ref: /schemas/media/video-interface-devices.yaml#

properties:
  compatible:
    const: st,vd55g0

  reg:
    maxItems: 1

  clocks:
    maxItems: 1

  VCORE-supply:
    description:
      Sensor digital core supply. Must be 1.2 volts.

  VDDIO-supply:
    description:
      Sensor digital IO supply. Must be 1.8 volts.

  VANA-supply:
    description:
      Sensor analog supply. Must be 2.8 volts.

  reset-gpios:
    description:
      Reference to the GPIO connected to the reset pin, if any.
      This is an active low signal to the vd55g0.
    maxItems: 1

  st,leds:
    description:
      Sensor LEDs GPIOs numbers to be used for illumination.
    $ref: /schemas/types.yaml#/definitions/uint32-array
    minItems: 1
    maxItems: 4
    items:
      minimum: 0
      maximum: 3

  st,out-sync:
    description:
      Sensor GPIOs numbers to output a synchronisation signal, used in
      conjonction with st,in-sync-gpios.
    $ref: /schemas/types.yaml#/definitions/uint32-array
    minItems: 1
    maxItems: 4
    items:
      minimum: 0
      maximum: 3

  st,in-sync:
    description:
      Sensor GPIO number to trigger Slave mode. If present the sensor will
      aquire frames only when a raising edge is received on this GPIO.
    $ref: /schemas/types.yaml#/definitions/uint32
    const: 0

  port:
    $ref: /schemas/graph.yaml#/$defs/port-base
    additionalProperties: false

    properties:
      endpoint:
        $ref: /schemas/media/video-interfaces.yaml#
        unevaluatedProperties: false

        properties:
          data-lanes:
            description:
              CSI lanes to use
            minItems: 1
            maxItems: 2
            items:
              enum: [1, 2]

          remote-endpoint: true

        required:
          - data-lanes

required:
  - compatible
  - reg
  - clocks
  - VCORE-supply
  - VDDIO-supply
  - VANA-supply
  - port

unevaluatedProperties: false

examples:
  - |
    #include <dt-bindings/gpio/gpio.h>
    i2c {
        #address-cells = <1>;
        #size-cells = <0>;
        vd55g0: csi2tx@10 {
            compatible = "st,vd55g0";
            reg = <0x10>;
            clocks = <&clk_ext_camera>;
            VCORE-supply = <&v1v2>;
            VDDIO-supply = <&v1v8>;
            VANA-supply = <&v2v8>;
            reset-gpios = <&mfxgpio 18 GPIO_ACTIVE_LOW>;
            st,leds = <0 1>;
            st,out-sync = <2 3>;
            port {
                ep0: endpoint {
                    data-lanes = <1 2>;
                    remote-endpoint = <&mipi_csi2_out>;
                };
            };
        };
    };
...
```
